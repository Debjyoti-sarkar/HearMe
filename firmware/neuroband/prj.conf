## CMakeLists.txt
```
cmake_minimum_required(VERSION 3.20.0)

find_package(Zephyr REQUIRED HINTS $ENV{ZEPHYR_BASE})
project(neuroband)

target_sources(app PRIVATE
    src/main.c
    src/bio_frame.c
    src/bio_service.c
    src/sensors.c
)

target_include_directories(app PRIVATE src)
```

## prj.conf
```kconfig
# NeuroBand firmware — Zephyr config
# Target: Nordic nRF52840 (DK or MDBT50Q-1MV2 module)

# ---- Logging ----
CONFIG_LOG=y
CONFIG_LOG_DEFAULT_LEVEL=3
CONFIG_USE_SEGGER_RTT=y
CONFIG_LOG_BACKEND_RTT=y
CONFIG_LOG_BACKEND_UART=n

# ---- Bluetooth ----
CONFIG_BT=y
CONFIG_BT_PERIPHERAL=y
CONFIG_BT_DEVICE_NAME="NeuroBand"
CONFIG_BT_DEVICE_APPEARANCE=833    # 0x0341 = Generic Heart Rate Sensor
CONFIG_BT_MAX_CONN=1
CONFIG_BT_MAX_PAIRED=1
CONFIG_BT_SETTINGS=y
CONFIG_FLASH=y
CONFIG_FLASH_MAP=y
CONFIG_NVS=y
CONFIG_SETTINGS=y

# Secure Connections + bonding — mandatory per Volume III security posture.
CONFIG_BT_SMP=y
CONFIG_BT_SMP_SC_PAIR_ONLY=y
CONFIG_BT_BONDABLE=y
CONFIG_BT_FIXED_PASSKEY=y          # PSK printed on strap binds the key
CONFIG_BT_GATT_AUTO_DISCOVER_CCC=y

# Larger MTU so the 20-byte BioFrame fits without fragmentation.
CONFIG_BT_BUF_ACL_RX_SIZE=64
CONFIG_BT_BUF_ACL_TX_SIZE=64
CONFIG_BT_L2CAP_TX_MTU=64
CONFIG_BT_GATT_CLIENT=n

# Advertise the manufacturer data containing the serial prefix.
CONFIG_BT_EXT_ADV=y

# ---- I2C for sensors ----
CONFIG_I2C=y

# ---- ADC for GSR + sEMG ----
CONFIG_ADC=y
CONFIG_ADC_ASYNC=y

# ---- GPIO / haptics / cap-touch ----
CONFIG_GPIO=y
CONFIG_PWM=y                       # for haptic LRA driving via DRV2605L

# ---- Power management ----
CONFIG_PM=y
CONFIG_PM_DEVICE=y

# ---- Misc ----
CONFIG_HEAP_MEM_POOL_SIZE=4096
CONFIG_MAIN_STACK_SIZE=2048
```

## src/main.c
```c
/*
 * NeuroBand main loop.
 *
 * Boots the BLE stack, advertises the HearMe Bio Service, and pushes a
 * 20-byte BioFrame at 1 Hz to whichever central is subscribed.
 *
 * Pair this firmware with the HearMe app's NeuroBand screen (Mock mode OFF).
 * The byte layout matches lib/neuroband-ble.ts decodeBioFrame exactly.
 */

#include "bio_frame.h"
#include "bio_service.h"
#include "sensors.h"

#include <zephyr/kernel.h>
#include <zephyr/logging/log.h>
#include <zephyr/bluetooth/bluetooth.h>
#include <zephyr/settings/settings.h>

LOG_MODULE_REGISTER(neuroband_main, LOG_LEVEL_INF);

#define FW_MAJOR     1
#define FW_MINOR     0

/* Bake your real serial in here — the first 4 chars are also broadcast in
 * scan response so the phone's pairing UI shows it. */
#define BAND_SERIAL  "NB1A-000001"

/* PSK printed on the strap — used as Bluetooth fixed passkey for SC pairing.
 * 6-digit numeric per BT spec. The 12-char alphanumeric PSK from the spec
 * is hashed down to a 6-digit value at provisioning time. */
#define BAND_PASSKEY 482915u

static uint16_t seq_counter;
static uint32_t monotonic_counter;

static void publish_frame(void) {
    struct bio_reading r;
    sensors_read(&r);

    uint8_t frame[20];
    bio_frame_pack(frame, seq_counter++, ++monotonic_counter, FW_MINOR, &r);

    int err = bio_service_notify_frame(frame);
    if (err < 0) {
        LOG_WRN("notify err=%d", err);
    }
}

void main(void) {
    int err;

    LOG_INF("NeuroBand fw %d.%d booting (serial=%s)", FW_MAJOR, FW_MINOR, BAND_SERIAL);

    err = sensors_init();
    if (err) {
        LOG_ERR("sensors_init err=%d", err);
    }

    err = bt_enable(NULL);
    if (err) {
        LOG_ERR("bt_enable err=%d", err);
        return;
    }

    if (IS_ENABLED(CONFIG_SETTINGS)) {
        settings_load();
    }

    /* Bind the strap-printed PSK as the SC passkey. */
    bt_passkey_set(BAND_PASSKEY);

    bio_service_set_device_info(FW_MAJOR, FW_MINOR, BAND_SERIAL);

    err = bio_service_init();
    if (err) {
        LOG_ERR("bio_service_init err=%d", err);
        return;
    }

    LOG_INF("ready — waiting for central");

    /* Main loop — 1 Hz publish. Keep this tight so the band sleeps as much
     * as possible between ticks; real power management with k_sleep + WFI
     * gives ~3-day battery on a 110 mAh cell. */
    while (1) {
        publish_frame();
        k_sleep(K_MSEC(1000));
    }
}
```

## src/bio_frame.c
```c
#include "bio_frame.h"

#include <string.h>

static inline void put_u16_le(uint8_t *p, uint16_t v) {
    p[0] = (uint8_t)(v & 0xff);
    p[1] = (uint8_t)((v >> 8) & 0xff);
}

static inline void put_i16_le(uint8_t *p, int16_t v) {
    put_u16_le(p, (uint16_t)v);
}

static inline void put_u32_le(uint8_t *p, uint32_t v) {
    p[0] = (uint8_t)(v & 0xff);
    p[1] = (uint8_t)((v >> 8) & 0xff);
    p[2] = (uint8_t)((v >> 16) & 0xff);
    p[3] = (uint8_t)((v >> 24) & 0xff);
}

static inline uint8_t clamp_u8(int v) {
    if (v < 0) return 0;
    if (v > 255) return 255;
    return (uint8_t)v;
}

static inline int16_t clamp_i16(int v) {
    if (v < -32768) return -32768;
    if (v > 32767) return 32767;
    return (int16_t)v;
}

static inline uint16_t clamp_u16(int v) {
    if (v < 0) return 0;
    if (v > 65535) return 65535;
    return (uint16_t)v;
}

size_t bio_frame_pack(uint8_t out[20],
                      uint16_t seq,
                      uint32_t counter,
                      uint8_t fw_minor,
                      const struct bio_reading *r) {
    /* Layout — see lib/neuroband-ble.ts decodeBioFrame:
     *  0   seq      u16 LE
     *  2   hr       u8
     *  3   hrv      u8
     *  4   spo2     u8
     *  5   gsr      u16 LE  (gsr_us * 100)
     *  7   temp     i16 LE  (skin_temp_c * 10)
     *  9   motion   u8
     *  10  semg     u8
     *  11  battery  u8
     *  12  flags    u8
     *  13  counter  u32 LE
     *  17  fw_minor u8
     *  18  reserved u8 (0)
     *  19  reserved u8 (0)
     */
    memset(out, 0, 20);

    put_u16_le(&out[0], seq);
    out[2]  = r->hr_bpm;
    out[3]  = r->hrv_rmssd_ms;
    out[4]  = r->spo2_pct;
    put_u16_le(&out[5], clamp_u16((int)(r->gsr_us * 100.0f + 0.5f)));
    put_i16_le(&out[7], clamp_i16((int)(r->skin_temp_c * 10.0f)));
    out[9]  = r->motion;
    out[10] = r->semg_envelope;
    out[11] = (r->battery_pct > 100) ? 100 : r->battery_pct;
    out[12] = r->flags;
    put_u32_le(&out[13], counter);
    out[17] = fw_minor;
    /* out[18..19] left zero — reserved */

    return 20;
}
```

## src/bio_frame.h
```c
/*
 * NeuroBand BioFrame — 20-byte packed payload sent over BLE notify at 1 Hz.
 *
 * The byte layout MUST match lib/neuroband-ble.ts decodeBioFrame in the
 * HearMe app. Don't change field order or sizes without changing both.
 */

#ifndef NEUROBAND_BIO_FRAME_H_
#define NEUROBAND_BIO_FRAME_H_

#include <stdint.h>
#include <stddef.h>

/* Motion classes — values must match MotionClass index in neuroband-ble.ts */
#define BF_MOTION_STILL    0
#define BF_MOTION_WALK     1
#define BF_MOTION_RUN      2
#define BF_MOTION_FALL     3
#define BF_MOTION_UNKNOWN  4

/* Flag bits */
#define BF_FLAG_CHARGING   (1u << 0)
#define BF_FLAG_TAMPER     (1u << 1)
#define BF_FLAG_LOW_BAT    (1u << 2)

/* Plain-language sensor reading — host-endian, what the firmware works with. */
struct bio_reading {
    uint8_t  hr_bpm;          /* 0..255 */
    uint8_t  hrv_rmssd_ms;    /* 0..255 */
    uint8_t  spo2_pct;        /* 0..100 typical */
    float    gsr_us;          /* µS */
    float    skin_temp_c;
    uint8_t  motion;          /* BF_MOTION_* */
    uint8_t  semg_envelope;   /* 0..255 normalised */
    uint8_t  battery_pct;
    uint8_t  flags;           /* BF_FLAG_* OR'd */
};

/* Pack a bio_reading + monotonic counter + sequence into the 20-byte
 * little-endian wire format. Returns the number of bytes written (always 20). */
size_t bio_frame_pack(uint8_t out[20],
                      uint16_t seq,
                      uint32_t counter,
                      uint8_t fw_minor,
                      const struct bio_reading *r);

#endif /* NEUROBAND_BIO_FRAME_H_ */
```

## src/bio_service.c
```c
#include "bio_service.h"

#include <zephyr/bluetooth/bluetooth.h>
#include <zephyr/bluetooth/conn.h>
#include <zephyr/bluetooth/gatt.h>
#include <zephyr/bluetooth/uuid.h>
#include <zephyr/kernel.h>
#include <zephyr/logging/log.h>
#include <string.h>

LOG_MODULE_REGISTER(bio_service, LOG_LEVEL_INF);

/* ---- UUIDs ----
 *
 * Base 128-bit UUID:  a89f3000-e5b8-4f7c-9e02-9b0c54a4e201
 *   - Service:        a89f3000-...
 *   - bio_frame:      a89f8001-...
 *   - silent_trigger: a89f8002-...
 *   - command:        a89f8003-...
 *   - device_info:    a89f8004-...
 *
 * BT_UUID_128_ENCODE byte order is reverse — keep this consistent with the
 * TypeScript constants in lib/neuroband-ble.ts.
 */
#define HEARME_UUID_BASE(short_) \
    BT_UUID_128_ENCODE(0xa89f0000u | ((uint32_t)(short_)), 0xe5b8, 0x4f7c, 0x9e02, 0x9b0c54a4e201ull)

static struct bt_uuid_128 hearme_svc_uuid           = BT_UUID_INIT_128(HEARME_UUID_BASE(0x3000));
static struct bt_uuid_128 hearme_bio_frame_uuid     = BT_UUID_INIT_128(HEARME_UUID_BASE(0x8001));
static struct bt_uuid_128 hearme_silent_uuid        = BT_UUID_INIT_128(HEARME_UUID_BASE(0x8002));
static struct bt_uuid_128 hearme_command_uuid       = BT_UUID_INIT_128(HEARME_UUID_BASE(0x8003));
static struct bt_uuid_128 hearme_device_info_uuid   = BT_UUID_INIT_128(HEARME_UUID_BASE(0x8004));

/* ---- Device info characteristic value ---- */
static uint8_t  device_info[2 + 24];     /* [fwMajor][fwMinor][serial] */
static size_t   device_info_len = 2;

/* ---- Subscription state ---- */
static struct bt_conn *current_conn;
static bool bio_frame_subscribed;

static void ccc_bio_frame_changed(const struct bt_gatt_attr *attr, uint16_t value) {
    bio_frame_subscribed = (value == BT_GATT_CCC_NOTIFY);
    LOG_INF("bio_frame subscribed=%d", bio_frame_subscribed);
}

/* Stub silent_trigger CCC handler — we don't gate on it but Zephyr requires
 * the descriptor to be declared if the characteristic is notifiable. */
static void ccc_silent_trigger_changed(const struct bt_gatt_attr *attr, uint16_t value) {
    LOG_INF("silent_trigger ccc=0x%04x", value);
}

/* device_info read — return packed [fwMajor][fwMinor][serial...] */
static ssize_t read_device_info(struct bt_conn *conn,
                                const struct bt_gatt_attr *attr,
                                void *buf, uint16_t len, uint16_t offset) {
    return bt_gatt_attr_read(conn, attr, buf, len, offset,
                             device_info, device_info_len);
}

/* command write handler — extend with real command parsing as needed. */
static ssize_t write_command(struct bt_conn *conn,
                             const struct bt_gatt_attr *attr,
                             const void *buf, uint16_t len, uint16_t offset, uint8_t flags) {
    if (offset != 0 || len < 1) return BT_GATT_ERR(BT_ATT_ERR_INVALID_OFFSET);
    const uint8_t *cmd = (const uint8_t *)buf;
    LOG_INF("command write: 0x%02x (len=%u)", cmd[0], len);

    switch (cmd[0]) {
    case 0x01:  /* haptic buzz */
        /* TODO: hand off to DRV2605L driver — see sensors.c haptic_buzz_short() */
        break;
    case 0x02:  /* enter calibration mode */
        break;
    default:
        break;
    }
    return len;
}

BT_GATT_SERVICE_DEFINE(hearme_bio_svc,
    BT_GATT_PRIMARY_SERVICE(&hearme_svc_uuid),

    /* bio_frame — notify */
    BT_GATT_CHARACTERISTIC(&hearme_bio_frame_uuid.uuid,
        BT_GATT_CHRC_NOTIFY,
        BT_GATT_PERM_NONE,
        NULL, NULL, NULL),
    BT_GATT_CCC(ccc_bio_frame_changed,
        BT_GATT_PERM_READ_ENCRYPT | BT_GATT_PERM_WRITE_ENCRYPT),

    /* silent_trigger — notify */
    BT_GATT_CHARACTERISTIC(&hearme_silent_uuid.uuid,
        BT_GATT_CHRC_NOTIFY,
        BT_GATT_PERM_NONE,
        NULL, NULL, NULL),
    BT_GATT_CCC(ccc_silent_trigger_changed,
        BT_GATT_PERM_READ_ENCRYPT | BT_GATT_PERM_WRITE_ENCRYPT),

    /* command — write (encrypted) */
    BT_GATT_CHARACTERISTIC(&hearme_command_uuid.uuid,
        BT_GATT_CHRC_WRITE,
        BT_GATT_PERM_WRITE_ENCRYPT,
        NULL, write_command, NULL),

    /* device_info — read */
    BT_GATT_CHARACTERISTIC(&hearme_device_info_uuid.uuid,
        BT_GATT_CHRC_READ,
        BT_GATT_PERM_READ,
        read_device_info, NULL, NULL),
);

/* attr index lookups — frame char value attr is index 2 (1-based after the
 * service decl), trigger value attr is index 5. Keep this in sync with the
 * SERVICE_DEFINE order above. */
#define ATTR_BIO_FRAME_VALUE   (&hearme_bio_svc.attrs[2])
#define ATTR_SILENT_VALUE      (&hearme_bio_svc.attrs[5])

int bio_service_notify_frame(const uint8_t frame[20]) {
    if (!current_conn || !bio_frame_subscribed) {
        return 0;  /* no subscriber — drop silently */
    }
    return bt_gatt_notify(current_conn, ATTR_BIO_FRAME_VALUE, frame, 20);
}

int bio_service_notify_trigger(uint8_t bits) {
    if (!current_conn) return 0;
    return bt_gatt_notify(current_conn, ATTR_SILENT_VALUE, &bits, 1);
}

bool bio_service_is_subscribed(void) {
    return current_conn && bio_frame_subscribed;
}

void bio_service_set_device_info(uint8_t fw_major, uint8_t fw_minor, const char *serial) {
    device_info[0] = fw_major;
    device_info[1] = fw_minor;
    size_t slen = strlen(serial);
    if (slen > sizeof(device_info) - 2) slen = sizeof(device_info) - 2;
    memcpy(&device_info[2], serial, slen);
    device_info_len = 2 + slen;
}

/* ---- Connection management + advertising ---- */

static void connected(struct bt_conn *conn, uint8_t err) {
    if (err) {
        LOG_WRN("connect failed err=0x%02x", err);
        return;
    }
    current_conn = bt_conn_ref(conn);
    LOG_INF("central connected");
}

static void disconnected(struct bt_conn *conn, uint8_t reason) {
    LOG_INF("central disconnected reason=0x%02x", reason);
    if (current_conn) {
        bt_conn_unref(current_conn);
        current_conn = NULL;
    }
    bio_frame_subscribed = false;
}

BT_CONN_CB_DEFINE(conn_callbacks) = {
    .connected = connected,
    .disconnected = disconnected,
};

static const struct bt_data ad[] = {
    BT_DATA_BYTES(BT_DATA_FLAGS, (BT_LE_AD_GENERAL | BT_LE_AD_NO_BREDR)),
    BT_DATA_BYTES(BT_DATA_UUID128_ALL,
        BT_UUID_128_ENCODE(0xa89f3000u, 0xe5b8, 0x4f7c, 0x9e02, 0x9b0c54a4e201ull)),
};

/* Manufacturer-data scan response carrying the first 4 chars of the serial
 * for the phone's pairing UI. Updated by main.c after bio_service_set_device_info. */
static uint8_t scan_resp_mfg[6] = { 0xff, 0xff, '?', '?', '?', '?' };
static struct bt_data scan_resp[] = {
    BT_DATA(BT_DATA_NAME_COMPLETE, "NeuroBand", 9),
    BT_DATA(BT_DATA_MANUFACTURER_DATA, scan_resp_mfg, sizeof(scan_resp_mfg)),
};

int bio_service_init(void) {
    int err;

    err = bt_le_adv_start(BT_LE_ADV_CONN_NAME, ad, ARRAY_SIZE(ad),
                          scan_resp, ARRAY_SIZE(scan_resp));
    if (err) {
        LOG_ERR("adv start failed err=%d", err);
        return err;
    }
    LOG_INF("advertising started");
    return 0;
}
```

## src/bio_service.h
```c
/*
 * HearMe Bio Service — custom 128-bit GATT service exposed by the band.
 * UUIDs MUST match lib/neuroband-ble.ts exactly.
 */

#ifndef NEUROBAND_BIO_SERVICE_H_
#define NEUROBAND_BIO_SERVICE_H_

#include <stdbool.h>
#include <stddef.h>
#include <stdint.h>

/* Notify the central with a freshly-packed 20-byte BioFrame. Safe to call
 * from a workqueue; returns 0 on success. If no central is subscribed, the
 * call is a no-op and still returns 0. */
int bio_service_notify_frame(const uint8_t frame[20]);

/* Notify a silent-trigger event (cap-touch, auto-fire, tamper). The byte
 * is bit0=triple-tap, bit1=auto-fired, bit2=tamper. */
int bio_service_notify_trigger(uint8_t trigger_bits);

/* Set the device-info characteristic. Format expected by the host:
 *   [fwMajor u8][fwMinor u8][serial UTF-8 ...]
 * The serial is also broadcast as manufacturer data so the phone scan list
 * can show it before connecting. */
void bio_service_set_device_info(uint8_t fw_major,
                                 uint8_t fw_minor,
                                 const char *serial);

/* True if a central is connected and has subscribed to bio_frame notifications. */
bool bio_service_is_subscribed(void);

/* Initialize the service + start advertising. Call once after bt_enable(). */
int bio_service_init(void);

#endif /* NEUROBAND_BIO_SERVICE_H_ */
```

## src/sensors.c
```c
/*
 * Sensor read layer.
 *
 * v1 of this file ships with synthetic readings so the firmware boots and
 * the BLE link can be validated before any sensors are physically wired.
 * Replace each `read_*` stub with the real I2C/ADC driver call as the
 * hardware comes online — function signatures don't change.
 *
 * Recommended driver source:
 *   - MAX30102 PPG     → Maxim app note 6409, or community Zephyr driver
 *   - Grove GSR        → Zephyr ADC API on AIN0
 *   - MAX30205 temp    → I2C addr 0x48, register 0x00 (16-bit two's complement, 0.00390625 °C/LSB)
 *   - BMI270 IMU       → Zephyr in-tree driver (CONFIG_BMI270=y)
 *   - DRV2605L haptic  → I2C addr 0x5A, fire effect via reg 0x04 + GO 0x0C
 *   - MyoWare 2.0 sEMG → ADC on AIN1, software envelope = abs() + EMA
 */

#include "sensors.h"

#include <zephyr/kernel.h>
#include <zephyr/logging/log.h>
#include <zephyr/random/random.h>
#include <math.h>

LOG_MODULE_REGISTER(sensors, LOG_LEVEL_INF);

/* ---- Synthetic-reading state machine ----
 *
 * Three modes: calm, active, duress. The firmware boots in calm; tap the
 * cap-touch pad three times to advance. This mirrors the JS-side mock so
 * you can test the BLE link with realistic data before sensors land.
 *
 * Once real drivers are in, delete the synthetic generator and replace
 * with direct sensor reads in sensors_read().
 */

enum sim_mode {
    SIM_CALM = 0,
    SIM_ACTIVE = 1,
    SIM_DURESS = 2,
};

static enum sim_mode sim = SIM_CALM;

void sensors_set_sim_mode(int m) {
    if (m >= 0 && m <= 2) sim = (enum sim_mode)m;
}

static float urand(float lo, float hi) {
    /* sys_rand32_get returns 0..UINT32_MAX */
    uint32_t r = sys_rand32_get();
    return lo + ((float)r / (float)UINT32_MAX) * (hi - lo);
}

int sensors_init(void) {
    /* TODO: probe MAX30102, MAX30205, BMI270 over I2C; enable ADC channels;
     * configure DRV2605L for an LRA. For now, just log and continue. */
    LOG_INF("sensors_init (synthetic mode)");
    return 0;
}

void sensors_read(struct bio_reading *r) {
    /* TODO: replace with real sensor reads. See top-of-file driver list. */

    switch (sim) {
    case SIM_DURESS:
        r->hr_bpm        = (uint8_t)urand(110, 130);
        r->hrv_rmssd_ms  = (uint8_t)urand(15, 35);
        r->spo2_pct      = (uint8_t)urand(91, 96);
        r->gsr_us        = urand(6.0f, 12.0f);
        r->skin_temp_c   = urand(31.6f, 32.4f);
        r->motion        = BF_MOTION_STILL;
        r->semg_envelope = (uint8_t)urand(140, 220);
        break;
    case SIM_ACTIVE:
        r->hr_bpm        = (uint8_t)urand(95, 115);
        r->hrv_rmssd_ms  = (uint8_t)urand(20, 50);
        r->spo2_pct      = (uint8_t)urand(96, 99);
        r->gsr_us        = urand(3.0f, 5.0f);
        r->skin_temp_c   = urand(33.2f, 34.0f);
        r->motion        = (urand(0, 1) > 0.4f) ? BF_MOTION_WALK : BF_MOTION_RUN;
        r->semg_envelope = (uint8_t)urand(40, 90);
        break;
    case SIM_CALM:
    default:
        r->hr_bpm        = (uint8_t)urand(64, 76);
        r->hrv_rmssd_ms  = (uint8_t)urand(35, 70);
        r->spo2_pct      = (uint8_t)urand(96, 99);
        r->gsr_us        = urand(2.0f, 3.0f);
        r->skin_temp_c   = urand(32.8f, 33.6f);
        r->motion        = BF_MOTION_STILL;
        r->semg_envelope = (uint8_t)urand(20, 60);
        break;
    }

    /* Battery + flags — replace with PMIC reads when available. */
    r->battery_pct = 78;
    r->flags = 0;  /* OR in BF_FLAG_LOW_BAT etc. as needed */
}

void haptic_buzz_short(void) {
    /* TODO: drive DRV2605L → fire effect 0x10 (Strong Buzz 100%). */
    LOG_INF("haptic buzz");
}
```

## src/sensors.h
```c
/*
 * Thin sensor abstraction layer. Real driver code goes in sensors.c —
 * the stubs there return synthetic readings so the firmware boots and
 * advertises before any sensor PCB is wired.
 */

#ifndef NEUROBAND_SENSORS_H_
#define NEUROBAND_SENSORS_H_

#include "bio_frame.h"

int  sensors_init(void);

/* Populate `r` with the latest readings. Always succeeds — missing sensors
 * fall back to last-known or default values rather than failing. */
void sensors_read(struct bio_reading *r);

/* Trigger one short haptic buzz on the LRA (DRV2605L). */
void haptic_buzz_short(void);

#endif /* NEUROBAND_SENSORS_H_ */
```
